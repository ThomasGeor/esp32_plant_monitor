## Kconfig
```kconfig
menu "My WiFi Configuration"
	
	config ESP_WIFI_SSID
        string "WiFi SSID"
        default "Vodafone_2.4G-12861"
        help
            SSID (network name) for the example to connect to.
	
	config ESP_WIFI_PASSWORD
        string "WiFi Password"
        default "tom_bill_katina"
        help
            WiFi password (WPA or WPA2) for the example to use.
	
	config ESP_WIFI_CHANNEL
        int "WiFi Channel"
        range 1 13
        default 1
        help
            WiFi channel (network channel) for the example to use.
    config ESP_MAX_STA_CONN
        int "Maximal STA connections"
        default 4
        help
            Max number of the STA connects to AP.
endmenu
```
